## firmware/baseboard/buildroot-overlay/Config.in
```kconfig
config BR2_PACKAGE_USB4VC
	bool "usb4vc"
	depends on BR2_PACKAGE_PYTHON3
	select BR2_PACKAGE_PYTHON_LUMA_OLED
	help
		USB4VC USB for Vintage Computers

config BR2_PACKAGE_PYTHON_LUMA_OLED
	bool "python-luma-oled"
	depends on BR2_PACKAGE_PYTHON3
	select BR2_PACKAGE_PYTHON_LUMA_CORE
	help
		Luma.OLED python package (FIXME: more details)

config BR2_PACKAGE_PYTHON_LUMA_CORE
	bool "python-luma-core"
	depends on BR2_PACKAGE_PYTHON3
	select BR2_PACKAGE_PYTHON_PILLOW
	select BR2_PACKAGE_PYTHON_PIGPIO
	select BR2_PACKAGE_PYTHON_SMBUS2
	select BR2_PACKAGE_PYTHON_PYFTDI
	select BR2_PACKAGE_PYTHON_CBOR2
	select BR2_PACKAGE_PYTHON_SPIDEV
	help
		Luma.Core python package

config BR2_PACKAGE_PYTHON_SMBUS2
	bool "python-smbus2"
	depends on BR2_PACKAGE_PYTHON3
	help
		SMBus2 pure python library

config BR2_PACKAGE_PYTHON_PYFTDI
	bool "python-pyftdi"
	depends on BR2_PACKAGE_PYTHON3
	select BR2_PACKAGE_PYTHON_PYUSB
	select BR2_PACKAGE_PYTHON_SERIAL
	help
		PyFTDI
```

## firmware/baseboard/buildroot-overlay/configs/usb4vc_raspberrypi_defconfig
```kconfig
BR2_arm=y
BR2_arm1176jzf_s=y
BR2_TOOLCHAIN_BUILDROOT_MUSL=y
BR2_TOOLCHAIN_BUILDROOT_CXX=y
BR2_SYSTEM_DHCP="eth0"
BR2_ROOTFS_POST_BUILD_SCRIPT="board/raspberrypi/post-build.sh"
BR2_ROOTFS_POST_IMAGE_SCRIPT="support/scripts/genimage.sh"
BR2_ROOTFS_POST_SCRIPT_ARGS="-c $(BR2_EXTERNAL)/boards/rpi/genimage-raspberrypi.cfg"
BR2_LINUX_KERNEL=y
BR2_LINUX_KERNEL_CUSTOM_TARBALL=y
BR2_LINUX_KERNEL_CUSTOM_TARBALL_LOCATION="$(call github,raspberrypi,linux,rpi-5.15.y)/linux-rpi-5.15.y-$(shell date +%Y%m%d).tar.gz"
BR2_LINUX_KERNEL_DEFCONFIG="bcmrpi"
BR2_LINUX_KERNEL_DTS_SUPPORT=y
BR2_LINUX_KERNEL_INTREE_DTS_NAME="bcm2708-rpi-b bcm2709-rpi-2-b bcm2710-rpi-3-b bcm2708-rpi-b-plus bcm2708-rpi-b-rev1 bcm2708-rpi-zero bcm2708-rpi-zero-w bcm2710-rpi-zero-2 bcm2710-rpi-zero-2-w"
BR2_LINUX_KERNEL_NEEDS_HOST_OPENSSL=y
BR2_PACKAGE_RPI_FIRMWARE=y
BR2_PACKAGE_RPI_FIRMWARE_BOOTCODE_BIN=y
BR2_PACKAGE_RPI_FIRMWARE_VARIANT_PI=y
BR2_PACKAGE_RPI_FIRMWARE_CONFIG_FILE="$(BR2_EXTERNAL)/boards/rpi/config.txt"
BR2_PACKAGE_RPI_WIFI_FIRMWARE=y
BR2_PACKAGE_DFU_UTIL=y
BR2_PACKAGE_STM32FLASH=y
BR2_PACKAGE_PYTHON3=y
BR2_TARGET_ROOTFS_EXT2=y
BR2_TARGET_ROOTFS_EXT2_4=y
BR2_TARGET_ROOTFS_EXT2_SIZE="120M"
# BR2_TARGET_ROOTFS_TAR is not set
BR2_PACKAGE_HOST_DOSFSTOOLS=y
BR2_PACKAGE_HOST_GENIMAGE=y
BR2_PACKAGE_HOST_MTOOLS=y
BR2_PACKAGE_USB4VC=y
```
